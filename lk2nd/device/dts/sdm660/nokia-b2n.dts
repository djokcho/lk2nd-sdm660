// SPDX-License-Identifier: BSD-3-Clause

#include <skeleton64.dtsi>
#include <lk2nd.dtsi>

/ {
	model = "Nokia 7 Plus";

	qcom,msm-id = <QCOM_ID_SDM660 0x0>; // <0x13d 0x0>
        qcom,board-id = <8 0>;
        qcom,pmic-id = <0x0001001b 0x0101011a 0x0 0x0>,
                       <0x0001001b 0x0201011a 0x0 0x0>;

};

&lk2nd {
	model = "Nokia 7 Plus";
	compatible = "nokia,b2n", "qcom,mtp", "qcom,sdm660-mtp";
};
